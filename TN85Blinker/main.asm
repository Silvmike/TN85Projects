;
; Blinker.asm
;
; Created: 28.12.2016 14:33:32
; Author : Michael Silvanovich
;

.NOLIST
.INCLUDE "tn85def.inc"
.LIST

.DEF portState=R16
.DEF temp=R17
.EQU LED_PIN=PB0

.MACRO Delay1M
; Generated by delay loop calculator
; at http://www.bretmulvey.com/avrdelay.html
;
; Delay 1 000 000 cycles
; 1s at 1.0 MHz
    ldi  r18, 6
    ldi  r19, 19
    ldi  r20, 174
L1: dec  r20
    brne L1
    dec  r19
    brne L1
    dec  r18
    brne L1
    rjmp PC+1
.ENDMACRO

reset:
    sbi DDRB,LED_PIN
    ldi portState,0

start:

	Delay1M

; Toggle LED state
    mov temp,portState
    sbrs temp,LED_PIN 
    ldi portState,(1<<LED_PIN)
    sbrc temp,LED_PIN 
    ldi portState,0
    out PORTB,portState
    
    rjmp start